## meta/meta-headunit/conf/layer.conf
```bitbake
# Layer configuration for meta-headunit
BBPATH .= ":${LAYERDIR}"

# We have a conf and classes directory, add to BBPATH
BBPATH .= ":${LAYERDIR}"

# We have a packages directory, add to BBFILES
BBFILES += "${LAYERDIR}/recipes-*/*/*.bb \
            ${LAYERDIR}/recipes-*/*/*.bbappend"

BBFILE_COLLECTIONS += "meta-headunit"
BBFILE_PATTERN_meta-headunit = "^${LAYERDIR}/"
BBFILE_PRIORITY_meta-headunit = "6"

LAYERDEPENDS_meta-headunit = "core"
LAYERSERIES_COMPAT_meta-headunit = "kirkstone langdale mickledore nanbield scarthgap"
```
